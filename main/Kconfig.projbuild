## main/Kconfig.projbuild
```kconfig
menu "Initial Configuration Settings"

    config WIFI_CONFIG_SSID
        string "Config wifi SSID"
        default "Pomo Config"
        help
            SSID made for initial configuration

    config WIFI_CONFIG_PASSWORD
        string "Config wifi password"
        default "pomoconfig"
        help
            Password for initial configuration wifi

    config SETUP_FS_BASE
        string "Base directory for SPIFFS filesystem"
        default "/www"

endmenu
```
